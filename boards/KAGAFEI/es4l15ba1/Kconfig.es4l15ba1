## boards/KAGAFEI/es4l15ba1/Kconfig.es4l15ba1
```kconfig
config BOARD_ES4L15BA1
	select SOC_NRF54L15_CPUAPP if BOARD_ES4L15BA1_NRF54L15_CPUAPP
	select SOC_NRF54L15_CPUFLPR if \
		BOARD_ES4L15BA1_NRF54L15_CPUFLPR || \
		BOARD_ES4L15BA1_NRF54L15_CPUFLPR_XIP
```

## boards/KAGAFEI/es4l15ba1/board.yml
```yaml
board:
  name: es4l15ba1
  vendor: KAGAFEI
  socs:
  - name: nrf54l15
    variants:
    - name: xip
      cpucluster: cpuflpr
```
